## src/Kconfig.projbuild
```kconfig
menu "Inverter Hardware Configuration"

choice ADC_MANAGER_MODE
    prompt "ADC acquisition mode"
    default ADC_MANAGER_MODE_CONTINUOUS
    help
        Select the ADC acquisition driver. Continuous/DMA is the default and
        is recommended for normal operation. Oneshot is the compatibility
        fallback. Exactly one driver is selected at compile time.

config ADC_MANAGER_MODE_CONTINUOUS
    bool "Continuous / DMA"

config ADC_MANAGER_MODE_ONESHOT
    bool "Oneshot fallback"

endchoice

choice INVERTER_LCD_GEOMETRY
    prompt "Physical LCD geometry"
    default INVERTER_LCD_20X4
    help
        Select the connected character LCD geometry. This changes only the
        rendering layout; it does not change ADC acquisition or safety policy.

config INVERTER_LCD_16X2
    bool "16x2 LCD"

config INVERTER_LCD_20X4
    bool "20x4 LCD"

endchoice

config INVERTER_BUTTON_DIAGNOSTICS
    bool "Enable physical button diagnostics"
    default n
    help
        Log one bounded diagnostic line per button approximately once per second.
        Diagnostics include GPIO level, stable level, pressed state, controller
        state, ISR calls, queue overflows, and emitted events. Leave disabled for
        normal operation.

endmenu

menu "Inverter Wi-Fi Configuration"

choice INVERTER_WIFI_OPERATION_MODE
    prompt "Wi-Fi operation mode"
    default INVERTER_WIFI_MODE_APSTA
    help
        Select the complete runtime architecture. STA connects to the
        configured home network only. AP exposes the inverter network only.
        APSTA exposes the inverter network and may connect to the home network
        when the user explicitly requests it.

config INVERTER_WIFI_MODE_STA
    bool "Station only"

config INVERTER_WIFI_MODE_AP
    bool "Access Point only"

config INVERTER_WIFI_MODE_APSTA
    bool "Access Point + Station"

endchoice

config INVERTER_WIFI_AP_MAX_CONNECTION
    int "Maximum Access Point clients"
    range 1 4
    default 4
    help
        Maximum number of devices allowed on the inverter Access Point.
        The firmware hard-caps this value at four.

config INVERTER_WIFI_STA_SSID
    string "Station SSID"
    default ""
    help
        SSID used by the inverter in Station mode. Leave empty to disable
        Station mode. Set this value with idf.py menuconfig before flashing.

config INVERTER_WIFI_STA_PASSWORD
    string "Station password"
    default ""
    help
        Password used by the inverter in Station mode. Leave empty only for
        an open network. Do not commit sdkconfig because it may contain this
        secret.

config INVERTER_WIFI_AP_SSID
    string "Access Point SSID"
    default "Vonix-Inverter"
    help
        SSID used by the optional Access Point. AP mode is disabled when the
        AP password is empty.

config INVERTER_WIFI_AP_PASSWORD
    string "Access Point password"
    default ""
    help
        Password used by the optional Access Point. An AP password must be at
        least 8 characters; an empty value disables AP mode. Never use an open
        AP in this firmware.

config INVERTER_WIFI_AP_CHANNEL
    int "Access Point channel"
    range 1 13
    default 6
    help
        Preferred AP channel. In AP+STA mode ESP-IDF may force the AP onto
        the Station channel; the firmware logs a warning if they differ.

choice INVERTER_WIFI_AUTH_MODE
    prompt "Wi-Fi authentication mode"
    default INVERTER_WIFI_AUTH_MODE_WPA_WPA2_PSK
    help
        Authentication mode used for the Station threshold and optional AP.

config INVERTER_WIFI_AUTH_MODE_WPA2_PSK
    bool "WPA2-PSK"

config INVERTER_WIFI_AUTH_MODE_WPA3_PSK
    bool "WPA3-PSK"

config INVERTER_WIFI_AUTH_MODE_WPA_WPA2_PSK
    bool "WPA/WPA2-PSK"

endchoice

config INVERTER_WIFI_RUNTIME_PROVISIONING
    bool "Enable runtime Wi-Fi provisioning"
    default n
    help
        Enable the captive portal, scan-and-enter-password UI, and runtime
        credential REST/BLE paths. This is disabled by default because the
        normal firmware uses compile-time menuconfig credentials.

config INVERTER_OTA_MANIFEST_URL
    string "Default OTA manifest URL"
    default "https://github.com/Jezzylinks/inverter/releases/latest/download/inverter.csv"
    help
        HTTPS CSV manifest URL used when no runtime OTA URL has been stored.
        Keep this endpoint under trusted release control. Runtime storage still
        validates the URL before every check and install.

endmenu
```
